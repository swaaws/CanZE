VERSION ""

NS_ :

BS_:

BU_:

BO_ 1624 SoH: 128 Vector__XXX
	SG_ SoH : 33|6@1+ (2,0) [0|100] "%" Vector__XXX

BO_ 1495 Speed: 128 Vector__XXX
	SG_ Speed : 0|15@1+ (0,0) [0|150] "km/H" Vector__XXX

BO_ 1070 SoC: 128 Vector__XXX
	SG_ SoC : 0|8@1+ (0,0) [0|100] "%" Vector__XXX

BO_ 1979 Cell01V: 128 Vector__XXX
	SG_ Cell01V : 16|31@1+ (0,0) [0|4.2] "V" Vector__XXX

BO_ 1893 TPMS: 120 Vector__XXX
	SG_ TPMS : 24|23@1+ (0,0) [0|0] "" Vector__XXX

BO_ 1063 Availkwh: 128 Vector__XXX
	SG_ availkwh : 49|8@1+ (0,0) [0|0] "kWh" Vector__XXX
	SG_ AvailChPow : 40|7@1+ (0,0) [0|0] "kW" Vector__XXX

	BO_ 1651 whilepresure: 128 Vector__XXX
	SG_ rr : 16|8@1+ (13.725,0) [0|0] "673,16,23,13.725,0,0,mbar,,,ff,Rear right wheel pressure" Vector__XXX
	SG_ rl : 24|8@1+ (13.725,0) [0|0] "673,24,31,13.725,0,0,mbar,,,ff,Rear left wheel pressure" Vector__XXX
	SG_ fr : 32|8@1+ (13.725,0) [0|0] "673,32,39,13.725,0,0,mbar,,,ff,Front right wheel pressure" Vector__XXX
	SG_ fl : 40|8@1+ (13.725,0) [0|0] "673,40,47,13.725,0,0,mbar,,,ff,Front left wheel pressure" Vector__XXX

BA_DEF_  "BusType" STRING ;
BA_DEF_DEF_  "BusType" "CAN";
